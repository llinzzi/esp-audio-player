## Kconfig
```kconfig
menu "Audio playback"

    config AUDIO_PLAYER_ENABLE_MP3
        bool "Enable mp3 decoding."
        default y
        help
            The audio player can play mp3 files using libhelix-mp3.
    config AUDIO_PLAYER_ENABLE_WAV
        bool "Enable wav file playback"
        default y
        help
            Audio player can decode wave files.

    config AUDIO_PLAYER_ENABLE_HTTP_STREAM
        bool "Enable HTTP streaming support"
        default n
        depends on AUDIO_PLAYER_ENABLE_MP3 || AUDIO_PLAYER_ENABLE_WAV
        help
            Enable support for streaming audio from HTTP/HTTPS URLs.
            Requires the esp_http_client component.

    if AUDIO_PLAYER_ENABLE_HTTP_STREAM

    config AUDIO_PLAYER_HTTP_DEFAULT_BUFFER_SIZE
        int "Default HTTP stream buffer size (bytes)"
        default 32768
        range 4096 262144
        help
            Default size of the ring buffer used for HTTP streaming.

    config AUDIO_PLAYER_HTTP_DEFAULT_LOW_WATERMARK
        int "Default HTTP stream low watermark (bytes)"
        default 8192
        range 1024 65536
        help
            Default low watermark for HTTP streaming. When buffer
            falls below this level, playback will pause to rebuffer.

    config AUDIO_PLAYER_HTTP_DEFAULT_HIGH_WATERMARK
        int "Default HTTP stream high watermark (bytes)"
        default 24576
        range 2048 131072
        help
            Default high watermark for HTTP streaming. When buffer
            reaches this level after buffering, playback will resume.

    endif

    config AUDIO_PLAYER_LOG_LEVEL
        int "Audio Player log level (0 none - 3 highest)"
        default 0
        range 0 3
        help
            Specify the verbosity of Audio Player log output.
endmenu
```
